## drivers/external/Kconfig
```kconfig
#
# external drivers configuration
#
menu "external Device Drivers"

config AMLOGIC_EXTERNAL_DRIVER
       tristate "amlogic external device support"
       default n
       help
         Say Y here if you want to use external device.

if AMLOGIC_EXTERNAL_DRIVER
source "$(COMMON_DRIVERS_DIR)/drivers/external/st7789v3_tft/Kconfig"
endif

endmenu
```

## drivers/fs/Kconfig
```kconfig
menu "Meson filesystem modification for common code"

config AMLOGIC_NTFS3_ISSUE
	bool "NTFS3 has bug when update parent"
	depends on NTFS3_FS
	help
	  ntfs3 has evict hang issue, amlogic provide a modification to fix it.

config AMLOGIC_DM_BOW_BUGFIX
	bool "DM BOW bug fix"
	depends on DM_BOW
	default n
	help
	  DM BOW bug fix by Amlogic.
endmenu
```

## drivers/media/common/media_wrapper/Kconfig
```kconfig
#
# media wrapper support configuration
#

menu "MediaWrapper support"

config AMLOGIC_MEDIA_WRAPPER
	tristate "MediaWrapper support"
	default n
	help
		Select to enable AMLOGIC MediaWrapper
endmenu
```
