## drivers/amfc/Kconfig
```kconfig
config AMLOGIC_AMFC
	tristate "Amlogic AMFC driver"
	default n
	help
		Amlogic AMFC driver for
		Hardware compress/decompress module
		This module can help for speed up
		zram and some other cases which using compress/decompress

choice
	prompt "AMFC soc"
	depends on AMLOGIC_AMFC
	default AMFC_S7D
	help
		select which soc for AMFC related drivers

config AMFC_S7D
	bool "AMFC on S7D"

config AMFC_T6D
	bool "AMFC on T6D"

config AMFC_T6W
	bool "AMFC on T6W"

endchoice

config AMFC_BASE
	hex "io base for decompress kernel"
	default 0xfe024000 if AMFC_S7D
	default 0xfe092000 if AMFC_T6D
	default 0xfe092000 if AMFC_T6W
	default 0xfe024000
	help
		Register base of AMFC for decompress uImage code.

config AMLOGIC_F2FS
	bool "AMLOGIC_F2FS filesystem support"
	depends on AMLOGIC_AMFC
	depends on F2FS_FS_COMPRESSION
	default n
	help
		AMLOGIC_F2FS is an optimzation for using amfc as f2fs compress
		backe-end, which can help to increase io performance on platform.

		If unsure, say N.

source "$(COMMON_DRIVERS_DIR)/drivers/amfc/aml_erofs/Kconfig"
```
